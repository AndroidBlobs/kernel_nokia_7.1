/* Copyright (c) 2018, The Linux Foundation. All rights reserved.
 *
 * This program is free software; you can redistribute it and/or modify
 * it under the terms of the GNU General Public License version 2 and
 * only version 2 as published by the Free Software Foundation.
 *
 * This program is distributed in the hope that it will be useful,
 * but WITHOUT ANY WARRANTY; without even the implied warranty of
 * MERCHANTABILITY or FITNESS FOR A PARTICULAR PURPOSE. See the
 * GNU General Public License for more details.
 */


/dts-v1/;

#include "sdm660.dtsi"

/* MemMap parts */
#include "fih/common/memmap-evb.dtsi"

/* Common DT Info */
#include "fih/nokia/common/common_info_sdm_v9.dtsi"

/* SYSTEM parts */
#include "fih/nokia/common/system-preEVT-660.dtsi"
/ {
	model = "Qualcomm Technologies, Inc. SDM 660 PM660 + PM660L MTP, FIH";
	compatible = "qcom,sdm660-mtp", "qcom,sdm660", "qcom,mtp";
	qcom,board-id = <8 0>;
	qcom,pmic-id = <0x0001001b 0x0101011a 0x0 0x0>,
			<0x0001001b 0x0201011a 0x0 0x0>;
	fih,hw-id = <0 0 0>;
};